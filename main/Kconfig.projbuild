## main/Kconfig.projbuild
```kconfig
menu "RNDL"
config RNDL_RESOLUTION_MHZ
    int "RNDL resolution in MHz"
    default 10
    help
        1 tick = 0.1us (RNDL strip needs a high resolution)

config RNDL_GPIO
    int "RNDL GPIO pin"
    default 2

config RNDL_RELAY_GPIO
    int "Relay GPIO pin (-1 to disable)"
    default -1
    help
        GPIO that controls the output power relay. Set to -1 if no relay is present.

config RNDL_RELAY_ACTIVE_LOW
    bool "Relay is active low"
    default n
    depends on RNDL_RELAY_GPIO != -1

config RNDL_BUTTON_GPIO
    int "Button GPIO pin (-1 to disable)"
    default -1
    help
        GPIO for the physical button that toggles relay power and clears LEDs. Set to -1 to disable.

config RNDL_BUTTON_DEBOUNCE_BITS
    int "Button debounce bit count"
    default 8
    range 1 31
    depends on RNDL_BUTTON_GPIO != -1
    help
        Number of consecutive identical samples required to register a press.
        Debounce period is RNDL_BUTTON_DEBOUNCE_BITS * RNDL_BUTTON_SAMPLE_MS. 

config RNDL_BUTTON_SAMPLE_MS
    int "Button sample interval (ms)"
    default 5
    range 1 50
    depends on RNDL_BUTTON_GPIO != -1

config RNDL_CHANNELS
    int "Number of LED channels"
    default 3

config RNDL_ROWS
    int "Number of LED panel rows"
    default 16

config RNDL_COLS
    int "Number of LED panel columns"
    default 32

config RNDL_FPS
    int "Render frames per second"
    default 100

config RNDL_RENDER_STACK_SIZE_BYTES
    int "Render stack size in bytes"
    default 1024

config RNDL_RENDER_PRIORITY
    int "Render task priority (higher is higher priority)"
    default 5
endmenu
```
